## config/west.yml
```yaml
# Point to repo with mouse support
# https://gist.github.com/krissen/dd27082e7ab0575619c7a31f4d2ec7ae

manifest:
  remotes:
    - name: zmkfirmware
      url-base: https://github.com/ftc/
    # - name: urob
    #   url-base: https://github.com/urob
  projects:
    - name: zmk
      remote: zmkfirmware
      revision: mouse-ftc
      # remote: urob
      # revision: masked-mods
      import: app/west.yml
  self:
    path: config
```
